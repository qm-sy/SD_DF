#include "NTC.h"

static uint16_t MF52E_tab[166] = {
143,/*-40*/    	150,/*-39*/    	157,/*-38*/    	166,/*-37*/    	175,/*-36*/
185,/*-35*/    	195,/*-34*/    	207,/*-33*/    	219,/*-32*/    	231,/*-31*/
245,/*-30*/    	259,/*-29*/    	274,/*-28*/    	290,/*-27*/    	306,/*-26*/
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3944,/*120*/    3948,/*121*/    3952,/*122*/    3955,/*123*/    3959,/*124*/
3963/*125*/    																							
};

/**
 * @brief	获取adc value 并查表找到对应温度
 * 
 * @param              
 *
 * @return  temp T1~T4 温度数组指针
 */
uint8_t *get_temp( void )
{
    static uint8_t temp[4];
    uint16_t adc_val[5] = {0};
    uint16_t temp1_adc = 0;
    uint16_t temp2_adc = 0;
    uint16_t temp3_adc = 0;
    uint16_t temp4_adc = 0;

    /* 1, 取10次adc_val                           */
    for( uint8_t t = 0; t < 10; t++ )
		{
			Get_ADC12bitResult(adc_val);
            temp1_adc = temp1_adc + adc_val[1];
            temp2_adc = temp2_adc + adc_val[2];
            temp3_adc = temp3_adc + adc_val[3];
            temp4_adc = temp4_adc + adc_val[4];
		}	       
    temp1_adc = (uint16_t)(temp1_adc / 10);
    temp2_adc = (uint16_t)(temp2_adc / 10);
    temp3_adc = (uint16_t)(temp3_adc / 10);
    temp4_adc = (uint16_t)(temp4_adc / 10);

    //printf(" The value of NTC1:%d  NTC1:%d  NTC1:%d  NTC1:%d \r\n",temp1_adc,temp2_adc,temp3_adc,temp4_adc);
    /* 2, 查表，找到对应温度值                     */
    temp[0] = LookupTable( MF52E_tab, 166, temp1_adc );
    temp[1] = LookupTable( MF52E_tab, 166, temp2_adc );
    temp[2] = LookupTable( MF52E_tab, 166, temp3_adc );
    temp[3] = LookupTable( MF52E_tab, 166, temp4_adc );

    //printf(" The value of NTC1:%d  NTC1:%d  NTC1:%d  NTC1:%d \r\n",temp[0],temp[1],temp[2],temp[3]);
    return temp;
}

/**
 * @brief	查表函数
 * 
 * @param              
 *
 * @return  temp_val adc value 对应的温度值
 */  
uint8_t LookupTable( uint16_t *temp_tab, uint8_t tab_num, uint16_t adc_val )
{
    uint8_t	temp_val = 0;

    
    for( uint8_t i = 0; i < tab_num ; i++ )
    {
        if( adc_val >= temp_tab[i] ) 
        {
            if( adc_val < temp_tab[i+1]) 
            {
                temp_val = i;
                //printf("here \r\n");
            }
        } 	
    }
    return temp_val;
}

